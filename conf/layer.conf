## conf/layer.conf
```bitbake
# We have a conf and classes directory, add to BBPATH
BBPATH .= ":${LAYERDIR}"

# We have recipes-* directories, add to BBFILES
BBFILES += "${LAYERDIR}/recipes-*/*/*.bb \
	${LAYERDIR}/recipes-*/*/*.bbappend"

BBFILE_COLLECTIONS += "meta-xenomai-imx7d"
BBFILE_PATTERN_meta-xenomai-imx7d = "^${LAYERDIR}/"
BBFILE_PRIORITY_meta-xenomai-imx7d = "6"

LAYERSERIES_COMPAT_meta-xenomai-imx7d = "rocko"
```
